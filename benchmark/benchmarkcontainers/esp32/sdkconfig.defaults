## server/cli/esp32/main/Kconfig.projbuild
```kconfig
menu "CatchChallenger server"

    config CATCHCHALLENGER_WIFI_SSID
        string "WiFi SSID"
        default "myssid"
        help
            SSID the ESP32 server joins (STA mode). DHCP gives it an address.

    config CATCHCHALLENGER_WIFI_PASSWORD
        string "WiFi password"
        default "mypassword"
        help
            WPA2 password for the SSID above. Set via `idf.py menuconfig`.

    config CATCHCHALLENGER_STATIC_IP
        string "Static IPv4 (empty = DHCP)"
        default ""
        help
            When non-empty, the STA uses this fixed IPv4 instead of DHCP
            (netmask/gateway below). Empty (the default) keeps DHCP, so a
            normal build is unaffected. Used to pin the board for benchmarking.

    config CATCHCHALLENGER_STATIC_NETMASK
        string "Static netmask"
        default "255.255.255.0"
        help
            Netmask applied only when CATCHCHALLENGER_STATIC_IP is non-empty.

    config CATCHCHALLENGER_STATIC_GATEWAY
        string "Static gateway"
        default ""
        help
            Gateway applied only when CATCHCHALLENGER_STATIC_IP is non-empty.

    config CATCHCHALLENGER_IDLE_CPU_FREQ_MHZ
        int "Idle CPU frequency in MHz (0 = always full speed)"
        default 0
        help
            Low-power build (needs PM_ENABLE, see sdkconfig.lowpower): the CPU
            drops to this frequency while idle and the WiFi modem sleeps
            between beacons. While the radio works the CPU still runs at
            80 MHz or more: the WiFi needs the PLL clock.

endmenu
```
