// HEADLESS: yes
// Measures std::vector vs std::list vs std::deque (the default container of
// std::queue) on REAL datapack data, read with the production loader: the
// files a server serves (base datapack + its biggest maincode), the maps of
// that maincode, the items, the monsters, plus the small FIFO the server
// Client keeps per player (DB callbacks, pending teleports).
// Containers: vector (push_back growth), vector_reserved (reserve(n) first, as a
// deserialiser does), list, deque. Metrics, per <dataset>.<container>:
//   build_ns_per_elem  ns      lower   construct by push_back, fixed time
//   scan_elems_per_s   1/s     higher  read-only full traversal, fixed time
//   heap_bytes         B       lower   heap really held by one built container
//   heap_blocks        blocks  lower   heap blocks of one built container
//   cpu_percent        %       lower   CPU over the cell (single thread: 100 = one core)
// FIFO, per fifo<depth>.<container>: ops_per_s (higher), allocs_per_op (lower),
// empty_heap_bytes (lower, what an EMPTY container already holds).
// Deterministic data; the timings are sampled (fixed-time window per cell).
//
// usage: benchmark_containers --datapack <dir> [--ms <window>] [--emit-esp32 <file.cpp> <max files>]
// --emit-esp32 writes the files + items datasets as C++ arrays for the ESP32
// firmware (benchmarkcontainers/esp32, no filesystem there) and exits.

#include "../../general/base/CommonDatapack.hpp"
#include "../../general/base/FacilityLibGeneral.hpp"
#include "../../general/base/Map_loader.hpp"

#include <sys/stat.h>
#include <algorithm>
#include <fstream>
#include <iostream>

// before ContainerBench.hpp: its templates must see these overloads
static uint64_t weight(const CatchChallenger::Monster &monster) { return monster.give_xp+monster.learn.size(); }
static uint64_t weight(const CatchChallenger::Map_to_send &map) { return map.width*map.height+map.teleport.size(); }

#include "ContainerBench.hpp"

// the .tmx under a folder, recursive and sorted (listFolder()'s 2nd argument is a sub-path, not a filter)
static std::vector<std::string> listMaps(const std::string &folder)
{
    const std::vector<std::string> all=CatchChallenger::FacilityLibGeneral::listFolder(folder);
    std::vector<std::string> maps;
    size_t index=0;
    while(index<all.size())
    {
        const std::string &name=all.at(index);
        if(name.size()>4 && name.compare(name.size()-4,4,".tmx")==0)
            maps.push_back(name);
        index++;
    }
    std::sort(maps.begin(),maps.end());
    return maps;
}

// the maincode with the most maps: the biggest world a server of this datapack loads
static std::string biggestMaincode(const std::string &datapack,size_t &mapCount)
{
    std::string best;
    mapCount=0;
    std::vector<CatchChallenger::FacilityLibGeneral::InodeDescriptor> dirs=
            CatchChallenger::FacilityLibGeneral::listFolderNotRecursive(datapack+"map/main/",
                                                                         CatchChallenger::FacilityLibGeneral::Dirs);
    std::sort(dirs.begin(),dirs.end());
    size_t index=0;
    while(index<dirs.size())
    {
        const size_t count=listMaps(datapack+"map/main/"+dirs.at(index).name+"/").size();
        if(count>mapCount)
        {
            mapCount=count;
            best=dirs.at(index).name;
        }
        index++;
    }
    return best;
}

static std::string cppString(const std::string &text)
{
    std::string out="\"";
    size_t index=0;
    while(index<text.size())
    {
        const char c=text[index];
        if(c=='"' || c=='\\')
            out+='\\';
        out+=c;
        index++;
    }
    return out+"\"";
}

static bool emitEsp32(const std::string &path,const std::vector<FileEntry> &files,const size_t &maxFiles,
                      const std::vector<ItemEntry> &items)
{
    std::ofstream out(path.c_str());
    if(!out.is_open())
    {
        std::cerr << "unable to write " << path << std::endl;
        return false;
    }
    const size_t fileCount=std::min(files.size(),maxFiles);
    out << "// GENERATED by benchmark_containers --emit-esp32, never commit\n"
        << "#include <stddef.h>\n#include <stdint.h>\n"
        << "extern const char * const cc_files_path[]; extern const uint32_t cc_files_size[];\n"
        << "extern const size_t cc_files_count; extern const uint32_t cc_items_price[];\n"
        << "extern const uint8_t cc_items_consume[]; extern const size_t cc_items_count;\n"
        << "const size_t cc_files_count=" << fileCount << ";\n"
        << "const char * const cc_files_path[]={\n";
    size_t index=0;
    while(index<fileCount)
    {
        out << cppString(files.at(index).path) << ",\n";
        index++;
    }
    out << "nullptr};\nconst uint32_t cc_files_size[]={\n";
    index=0;
    while(index<fileCount)
    {
        out << files.at(index).size << ",\n";
        index++;
    }
    out << "0};\nconst size_t cc_items_count=" << items.size() << ";\nconst uint32_t cc_items_price[]={\n";
    index=0;
    while(index<items.size())
    {
        out << items.at(index).price << ",\n";
        index++;
    }
    out << "0};\nconst uint8_t cc_items_consume[]={\n";
    index=0;
    while(index<items.size())
    {
        out << (items.at(index).consumeAtUse?1:0) << ",\n";
        index++;
    }
    out << "0};\n";
    out.close();
    return !out.fail();
}

int main(int argc,char *argv[])
{
    std::string datapack;
    std::string emitPath;
    size_t emitMaxFiles=0;
    int index=1;
    while(index<argc)
    {
        const std::string arg=argv[index];
        if(arg=="--datapack" && index+1<argc)
        {
            datapack=argv[index+1];
            index++;
        }
        else if(arg=="--ms" && index+1<argc)
        {
            g_windowNs=static_cast<uint64_t>(std::strtoull(argv[index+1],nullptr,10))*1000000;
            index++;
        }
        else if(arg=="--emit-esp32" && index+2<argc)
        {
            emitPath=argv[index+1];
            emitMaxFiles=static_cast<size_t>(std::strtoull(argv[index+2],nullptr,10));
            index+=2;
        }
        else
        {
            std::cerr << "unknown argument: " << arg << std::endl;
            return 2;
        }
        index++;
    }
    if(datapack.empty() || g_windowNs==0)
    {
        std::cerr << "usage: " << argv[0] << " --datapack <dir> [--ms <window>] [--emit-esp32 <file.cpp> <max files>]" << std::endl;
        return 2;
    }
    if(datapack.back()!='/')
        datapack+='/';

    size_t maincodeMaps=0;
    const std::string maincode=biggestMaincode(datapack,maincodeMaps);
    if(maincode.empty())
    {
        std::cerr << "no maincode with a .tmx under map/main/" << std::endl;
        return 1;
    }
    const std::string mainPrefix="map/main/"+maincode+"/";

    //files: what a server of that maincode serves (base datapack + its maincode)
    std::vector<FileEntry> files;
    {
        std::vector<std::string> list=CatchChallenger::FacilityLibGeneral::listFolder(datapack);
        std::sort(list.begin(),list.end());
        size_t fileIndex=0;
        while(fileIndex<list.size())
        {
            const std::string &path=list.at(fileIndex);
            if(path.compare(0,9,"map/main/")!=0 || path.compare(0,mainPrefix.size(),mainPrefix)==0)
            {
                struct stat info;
                if(::stat((datapack+path).c_str(),&info)==0)
                {
                    FileEntry entry;
                    entry.path=path;
                    entry.size=static_cast<uint32_t>(info.st_size);
                    files.push_back(entry);
                }
                else
                    std::cerr << "stat failed: " << path << std::endl;
            }
            fileIndex++;
        }
    }

    //the loader narrates on stdout: muffle it, stdout is the BENCH data
    std::cout.setstate(std::ios_base::badbit);
    std::cerr.setstate(std::ios_base::badbit);
    //items and monsters, then the maps (tryLoadMap aborts without parseDatapack first)
    CatchChallenger::CommonDatapack::commonDatapack.parseDatapack(datapack);
    std::vector<ItemEntry> items;
    {
        uint32_t id=0;
        while(id<=CatchChallenger::CommonDatapack::commonDatapack.get_itemMaxId())
        {
            if(CatchChallenger::CommonDatapack::commonDatapack.has_item(static_cast<CATCHCHALLENGER_TYPE_ITEM>(id)))
            {
                const CatchChallenger::Item &item=CatchChallenger::CommonDatapack::commonDatapack.get_item(static_cast<CATCHCHALLENGER_TYPE_ITEM>(id));
                ItemEntry entry;
                entry.price=item.price;
                entry.consumeAtUse=item.consumeAtUse;
                items.push_back(entry);
            }
            id++;
        }
    }
    std::cout.clear();
    std::cerr.clear();
    if(!emitPath.empty())
        return emitEsp32(emitPath,files,emitMaxFiles,items)?0:1;
    std::cout.setstate(std::ios_base::badbit);
    std::cerr.setstate(std::ios_base::badbit);
    std::vector<CatchChallenger::Monster> monsters;
    {
        uint32_t id=0;
        while(id<=CatchChallenger::CommonDatapack::commonDatapack.get_monstersMaxId())
        {
            if(CatchChallenger::CommonDatapack::commonDatapack.has_monster(static_cast<CATCHCHALLENGER_TYPE_MONSTER>(id)))
                monsters.push_back(CatchChallenger::CommonDatapack::commonDatapack.get_monster(static_cast<CATCHCHALLENGER_TYPE_MONSTER>(id)));
            id++;
        }
    }
    std::vector<CatchChallenger::Map_to_send> maps;
    unsigned int mapsFailed=0;
    {
        const std::string mapPath=datapack+mainPrefix;
        const std::vector<std::string> tmx=listMaps(mapPath);
        CatchChallenger::Map_loader loader;
        size_t mapIndex=0;
        while(mapIndex<tmx.size())
        {
            CatchChallenger::CommonMap scratch;
            scratch.width=0;
            scratch.height=0;
            if(loader.tryLoadMap(mapPath+tmx.at(mapIndex),scratch,true))
            {
                maps.push_back(loader.map_to_send);
                maps.back().xmlRoot=nullptr;//the XML document is freed below
            }
            else
                mapsFailed++;
            loader.map_to_send=CatchChallenger::Map_to_send();
            CatchChallenger::CommonDatapack::commonDatapack.clear_xmlLoadedFile();
            CatchChallenger::Map_loader::teleportConditionsUnparsed.clear();
            mapIndex++;
        }
    }
    std::cout.clear();
    std::cerr.clear();
    print("maincode_maps",static_cast<double>(maincodeMaps));
    print("maps_failed",static_cast<double>(mapsFailed));

    measureAll("files",files);
    measureAll("maps",maps);
    measureAll("items",items);
    measureAll("monsters",monsters);
    measureFifos();
    print("done",1);
    return 0;
}
